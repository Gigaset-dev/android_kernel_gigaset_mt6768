## drivers/input/touchscreen/focaltech_touch_ft8725/Kconfig
```kconfig
#
# Focaltech Touchscreen driver configuration
#

config TOUCHSCREEN_FTS_FT8725
    bool "Focaltech Touchscreen ft8725"
    default n
    help
      Say Y here if you have Focaltech touch panel.
      If unsure, say N.
      
config TOUCHSCREEN_FTS_DIRECTORY
    string "Focaltech ts directory name"
    default "focaltech_touch"
    depends on TOUCHSCREEN_FTS_FT8725
```

## drivers/misc/prize/cw_scannerctrl/Kconfig
```kconfig
config PRIZE_CW9281_SCANNER_CTRL
	bool "TTM for TTM"
	help
	  It support TTM control.
```
